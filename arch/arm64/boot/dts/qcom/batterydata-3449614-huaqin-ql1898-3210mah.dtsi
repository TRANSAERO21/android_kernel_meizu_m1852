qcom,3449614_huaqin_ql1898_3210mah_averaged_masterslave_may29th2018 {
	qcom, = <0x18>;
	qcom,max-voltage-uv = <0x432380>;
	qcom,nom-batt-capacity-mah = <0xc8a>;
	qcom,batt-id-kohm = <0x2f>;
	qcom,battery-beta = <0xd6b>;
	qcom,fg-cc-cv-threshold-mv = <0x1126>;
	qcom,fastchg-current-ma = <0xaf0>;
	qcom,jeita-fcc-ranges = <0x00  0x64  0x9eb10
				 0x65  0xc8  0xe7ef0
				 0xc9  0x1a4 0x2ab980
				 0x1a5 0x258 0x186a00>;
	qcom,jeita-fv-ranges = <0x00  0x64  0x432380
				0x65  0xc8  0x432380 
				0xc9  0x1c2 0x432380 
				0x1c3 0x258 0x3e8fa0>;
	qcom,battery-type = "VEKEN";
	qcom,checksum = <0x4ff6>;
	qcom,gui-version = "PM660GUI - 0.0.0.45";
	qcom,fg-profile-data = [
		0xb61e9706 0x7c0307f4
		0xcc1c4402 0xa0d850b
		0xac170e2a 0xf14dd35a
		0x64000000 0xf000000
		0x71b5 0xa6c4bdbb
		0x22000800 0x4fe276e4
		0x6405ba01 0x9d0cad0b
		0x7ced6e2b 0x27060920
		0x27001400 0xc11f8805
		0x8a0a3a06 0xbb1c1e03
		0xd5156112 0x7f18f623
		0xc14d885b 0x68000000
		0xd000000 0xa1d5
		0xcbc2a0ca 0x18000000
		0x63ea76e4 0xb3fcc7f3
		0x35fd3c02 0x2eda1322
		0xb633ccff 0x7100000
		0xa40c6646 0x18004000
		0xcc010afa 0xff000000
		0x00 0x00
		0x00 0x00
		0x00 0x00
		0x00 0x00
		0x00 0x00
		0x00 0x00
		0x00 0x00
		0x00 0x00
		0x00 0x00
	];
};
