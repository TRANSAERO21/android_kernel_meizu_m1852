qcom,3488744_huaqin_ql1898_atl_3210mah_averaged_masterslave_jul31st2018 {
	qcom,max-voltage-uv = <0x432380>;
	qcom,fg-cc-cv-threshold-mv = <0x1126>;
	qcom,nom-batt-capacity-mah = <0xc8a>;
	qcom,batt-id-kohm = <0x64>;
	qcom,battery-beta = <0xd34>;
        iqcom,fastchg-current-ma = <0xaf0>;
	qcom,jeita-fcc-ranges = <0x00  0x64  0x9eb10
				 0x65  0xc8  0xe7ef0
				 0xc9  0x1a4 0x2ab980
				 0x1a5 0x258 0x186a00>;
	qcom,jeita-fv-ranges = <0x00  0x64  0x432380
				0x65  0xc8  0x432380
				0xc9  0x1c2 0x432380
				0x1c3 0x258 0x3e8fa0>;
	qcom,battery-type = "ATL";
	qcom,checksum = <0x5c65>;
	qcom,gui-version = "PM660GUI - 0.0.0.45";
	qcom,fg-profile-data = [
		0x9b1f6f05 0x800a6d06
		0x731be50a 0xd41d4f1a
		0x6117b022 0x533ca34b
		0x5f000000 0x15000000
		0x92bc 0x7fc40200
		0x1d000800 0x1aeacaf5
		0xc206ac00 0xedea7c0a
		0x84d49922 0x49060920
		0x27001400 0x8f206904
		0x580b8b05 0x8a1b200b
		0xa01d7e1a 0x20187022
		0x943c894b 0x62000000
		0x14000000 0x61cd
		0x9dbab9c5 0x17000000
		0x61f3caf5 0xbff43ceb
		0xc5f2ff0a 0x3001f21a
		0xb133ccff 0x7100000
		0xc30c6646 0x17004000
		0xa4010afa 0xff000000
		0x00 0x00
		0x00 0x00
		0x00 0x00
		0x00 0x00
		0x00 0x00
		0x00 0x00
		0x00 0x00
		0x00 0x00
		0x00 0x00
	];
};
